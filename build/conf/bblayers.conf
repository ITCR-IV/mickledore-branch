## build/conf/bblayers.conf
```bitbake
# POKY_BBLAYERS_CONF_VERSION is increased each time build/conf/bblayers.conf
# changes incompatibly
POKY_BBLAYERS_CONF_VERSION = "2"

BBPATH = "${TOPDIR}"
BBFILES ?= ""

BBLAYERS ?= " \
  /home/igna/repos/poky/meta \
  /home/igna/repos/poky/meta-poky \
  /home/igna/repos/poky/meta-yocto-bsp \
  /home/igna/repos/poky/meta-raspberrypi \
  /home/igna/repos/poky/meta-openembedded/meta-oe \
  /home/igna/repos/poky/meta-openembedded/meta-python \
  /home/igna/repos/poky/meta-openembedded/meta-multimedia \
  /home/igna/repos/poky/meta-openembedded/meta-networking \
  /home/igna/repos/poky/build/workspace \
  "
```

## meta-casaint/conf/layer.conf
```bitbake
# We have a conf and classes directory, add to BBPATH
BBPATH .= ":${LAYERDIR}"

# We have recipes-* directories, add to BBFILES
BBFILES += "${LAYERDIR}/recipes-*/*/*.bb \
            ${LAYERDIR}/recipes-*/*/*.bbappend"

BBFILE_COLLECTIONS += "meta-casaint"
BBFILE_PATTERN_meta-casaint = "^${LAYERDIR}/"
BBFILE_PRIORITY_meta-casaint = "6"

LAYERDEPENDS_meta-casaint = "meta-python"
LAYERSERIES_COMPAT_meta-casaint = "mickledore"
```
